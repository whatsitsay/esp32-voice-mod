/**
 * @file algo_common.c
 * @author Gabriel Kaufman (whatsitsay)
 * @brief Implementation for algo_common library for all phase vocoder techniques
 * @version 0.1
 * @date 2023-09-29
 * 
 */

#include <math.h>
#include <string.h>
#include "sdkconfig.h"
#include "esp_err.h"
#include "esp_dsp.h"
#include "freertos/FreeRTOS.h"
#include "algo_common.h"

// root-Hann window for N=4096
#define HANN_WIN_LEN (4096)
#define HANN_WIN_IDX_MULT (HANN_WIN_LEN / N_SAMPLES) // Index multiplier to account for smaller N
static const float ROOT_HANN_WIN_LUT[HANN_WIN_LEN] = {
  0,
  0.00076699,
  0.00153398,
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  0.00153398,
  0.00076699
};

esp_err_t calc_fft(float* data_arr, int num_samples)
{
  esp_err_t resp = ESP_OK;
  // Calculate FFT itself from signal data
  resp |= dsps_fft2r_fc32(data_arr, num_samples); 
  // Perform bit reversal (necessary due to nature of implementation)
  resp |= dsps_bit_rev_fc32(data_arr, num_samples); 
  return resp;
}

void fill_mirror_fft(float* fft_arr, int num_samples)
{
  // Start from 2 as max frequency is excluded from even FFT size
  // Thus, min frequency should be as well
  for (int i = 2; i < num_samples; i+= 2)
  {
    // For real signals, second half after Nyquist freq will mirror
    // first half, but with complex conjugate.
    // Thus, copy first half of array in reverse order to the end
    // of the array and flip the sign of the imaginary component (2nd)
    int mirror_idx = (2 * num_samples) - i;
    fft_arr[mirror_idx]   = fft_arr[i];
    fft_arr[mirror_idx+1] = fft_arr[i+1] * -1; // Sign flipped for conjugate
  }
}

esp_err_t inv_fft(float* fft_arr, int num_samples)
{
    // Perform FFT on conjugate of original FFT
    // Invert all imaginary values by multiplying by -1
    // This entails all odd entries
    dsps_mulc_f32(fft_arr+1, fft_arr+1, num_samples, -1, 2, 2);

    // Calc FFT from conjugate-mirrored data
    esp_err_t resp = calc_fft(fft_arr, num_samples);

    // Modify resultant iFFT array
    // First divide by number samples, by multiplying all entries by inverse
    float corr_factor = 1.0 / (float)num_samples;
    dsps_mulc_f32(fft_arr, fft_arr, 2 * num_samples, corr_factor, 1, 1);
    // Then get conjugate again by multiplying all imaginary components by -1
    dsps_mulc_f32(fft_arr+1, fft_arr+1, num_samples, -1, 2, 2);

    return resp;
}

float calc_fft_mag_db(float* fft_arr, float* fft_mag, int num_samples)
{
  float max_mag_db = -INFINITY;
  for (int i = 0; i < num_samples; i++) {
    // Convert from I2S 24-bit data to voltage
    float real = fft_arr[2 * i] * I2S_VOLTAGE_CONV;
    float imag = fft_arr[2 * i + 1] * I2S_VOLTAGE_CONV;

    float mag_raw = sqrtf((real * real) + (imag * imag));

    fft_mag[i] = 20 * log10f(mag_raw);
    // Store maximum magnitude
    if (fft_mag[i] > max_mag_db) max_mag_db = fft_mag[i];
  }

  // Return maximum magnitude
  return max_mag_db;
}

float get_idx_phase(float* fft_arr, int idx)
{
  // Assumes FFT is in the format arr[2 * N] with odd samples being real, and even imaginary
  float real = fft_arr[2 * idx];
  float imag = fft_arr[2 * idx + 1];

  // Ensure there is no divide-by-zero operation
  if (imag == 0) return 0.0; // Same as atan(0)
  if (real == 0) return M_PI / 2; // Exact result of atan(inf)
  return atanf(imag / real);
}

void calc_fft_phase(float* fft_arr, float* fft_phase, int num_samples)
{
  for (int i = 0; i < num_samples; i++) {
    fft_phase[i] = get_idx_phase(fft_arr, i);
  }
}

void mult_complex(float x_real, float x_imag, float y_real, float y_imag, float* prod_real, float* prod_imag)
{
  *prod_real = (x_real * y_real) - (x_imag * y_imag);
  *prod_imag = (x_real * y_imag) + (x_imag * y_real);
}

void divide_complex(float x_real, float x_imag, float y_real, float y_imag, float* div_real, float* div_imag)
{
  float den = (y_real * y_real)+ (y_imag * y_imag);
  *div_real = ((x_real * y_real) + (x_imag * y_imag)) / den;
  *div_imag = ((x_imag * y_real) - (x_real * y_imag)) / den;
}

void polar_to_complex(float mag, float angle, float* cpx_real, float* cpx_imag)
{
  // Real is the cosine of the angle, imaginary the sine
  *cpx_real = mag * cosf(angle);
  *cpx_imag = mag * cosf(angle);
}

float get_window(int idx)
{
  // Raise exception if idx > sample size
  configASSERT( idx < N_SAMPLES );

  return ROOT_HANN_WIN_LUT[idx * HANN_WIN_IDX_MULT];
}

float interpolate_val(int x, int x_1, int x_0, float* y_arr)
{
  // Formula for interpolation is:
  // Y(x) = Y(x_0)+(x-x_0)/(x_1-x_0)*(Y(x_1)-Y(x_0))
  return y_arr[x_0] + ((y_arr[x_1] - y_arr[x_0])/(x_1 - x_0))*(x - x_0);
}